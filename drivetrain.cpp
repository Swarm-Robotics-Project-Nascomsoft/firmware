#include "drivetrain.h"

static const uint8_t zeroSpeed = 90;

static const uint8_t maxSpeed = 180;

// NEW: L298N needs one PWM channel + two direction pins per motor, instead of one Servo
// object per motor. ESP32 PWM is generated by the LEDC peripheral, addressed by channel
// number rather than by pin directly, so channels are allocated here.

static const uint32_t FREQ_HZ = 5000;
static const uint8_t RESOLUTION_BITS = 8;
static const uint8_t PWM_MAX_DUTY = 255;


static volatile uint32_t lastCommandTime_ms;

static volatile bool motorsStopped = true;
static const uint32_t driveTimeout_ms = 8000;

// NEW: sets one motor's direction (via in1/in2) and speed (via PWM channel) from a single
// 0-180 value, where 90 = stop, >90 = forward, <90 = reverse. This replaces what
// servoX.write(speed) used to do in one call - L298N needs direction and magnitude set
// separately, so this helper keeps drivetrainSetSpeed() itself close to its original shape.
static void driveMotor(uint8_t speed, uint8_t in1Pin, uint8_t in2Pin, uint8_t pwmPin) {
    if (speed == zeroSpeed) {
        digitalWrite(in1Pin, LOW);
        digitalWrite(in2Pin, LOW);
        ledcWrite(pwmPin, 0);
    } else if (speed > zeroSpeed) {
        digitalWrite(in1Pin, HIGH);
        digitalWrite(in2Pin, LOW);
        uint32_t duty = (uint32_t)(speed - zeroSpeed) * PWM_MAX_DUTY / (maxSpeed - zeroSpeed);
        ledcWrite(pwmPin, duty);
    } else {
        digitalWrite(in1Pin, LOW); 
        digitalWrite(in2Pin, HIGH);
        uint32_t duty = (uint32_t)(zeroSpeed - speed) * PWM_MAX_DUTY / zeroSpeed;
        ledcWrite(pwmPin, duty);
    }
}

// NEW: L298N "dynamic brake" - driving both direction pins high shorts the motor windings
// through the H-bridge, which stops the motor faster than coasting (driveMotor's zeroSpeed
// case). Used only for the dead-man timeout in drivetrainTask(), not for a normal commanded
// stop. FLAG FOR TEAM: this is a judgment call, not a locked decision - if brake causes
// excessive current draw/heat on our specific motors, swap this for driveMotor(zeroSpeed,...)
// (coast) instead.
static void driveMotorBrake(uint8_t in1Pin, uint8_t in2Pin, uint8_t pwmPin) {
    digitalWrite(in1Pin, HIGH);
    digitalWrite(in2Pin, HIGH);
    ledcWrite(pwmPin, 0);
}

void drivetrainSetSpeed(uint8_t speed1, uint8_t speed2) {
    // Store current time
    lastCommandTime_ms = millis();

    motorsStopped = false;
    char debugStr[50];
    sprintf(debugStr, "Speed1, Speed2:\t %d, %d\n", speed1, speed2);
    Serial.println(debugStr);

    driveMotor(speed1, MOTOR1_IN1_PIN, MOTOR1_IN2_PIN, MOTOR1_ENA_PIN);
    driveMotor(speed2, MOTOR2_IN3_PIN, MOTOR2_IN4_PIN, MOTOR2_ENB_PIN);
}

void drivetrainInit(void) {
    pinMode(MOTOR1_IN1_PIN, OUTPUT);
    pinMode(MOTOR1_IN2_PIN, OUTPUT);
    pinMode(MOTOR2_IN3_PIN, OUTPUT);
    pinMode(MOTOR2_IN4_PIN, OUTPUT);

    bool motor1=ledcAttach(MOTOR1_ENA_PIN, FREQ_HZ, RESOLUTION_BITS);
    bool motor2=ledcAttach(MOTOR2_ENB_PIN, FREQ_HZ, RESOLUTION_BITS);

    if (!motor1) {
    Serial.println("ERROR: ledcAttach failed for MOTOR1_ENA_PIN");
    }
    if (!motor2) {
    Serial.println("ERROR: ledcAttach failed for MOTOR2_ENB_PIN");
    }


    driveMotor(zeroSpeed, MOTOR1_IN1_PIN, MOTOR1_IN2_PIN, MOTOR1_ENA_PIN);
    driveMotor(zeroSpeed, MOTOR2_IN3_PIN, MOTOR2_IN4_PIN, MOTOR2_ENB_PIN); 
    motorsStopped = true;
}

void drivetrainTask(void) {
    uint32_t currentTime_ms = millis();
    if (lastCommandTime_ms + driveTimeout_ms <= currentTime_ms && !motorsStopped) {

        driveMotorBrake(MOTOR1_IN1_PIN, MOTOR1_IN2_PIN, MOTOR1_ENA_PIN);
        driveMotorBrake(MOTOR2_IN3_PIN, MOTOR2_IN4_PIN, MOTOR2_ENB_PIN);
        motorsStopped = true;
    }
}